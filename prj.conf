## CMakeLists.txt
```
# Vähimmäisversio CMakea Zephyr-projekteille
cmake_minimum_required(VERSION 3.21.0)

# Etsitään Zephyr-järjestelmä (tämä on pakollinen)
find_package(Zephyr REQUIRED HINTS $ENV{ZEPHYR_BASE})

# Projektin nimi (voit vaihtaa vapaasti)
project(RTOStehtava3)

# Lähdekoodit
target_sources(app PRIVATE
    src/main.c
    src/led_example.c
    src/dispatcher.c
    src/uartDef.c
    src/button_example.c
)
```

## prj.conf
```kconfig
CONFIG_GPIO=y
CONFIG_MAIN_STACK_SIZE=1024
CONFIG_PRINTK=y
CONFIG_THREAD_NAME=y

# UART driverit käyttöön
CONFIG_SERIAL=y
CONFIG_UART_INTERRUPT_DRIVEN=y

# FIFO ja malloc käyttöön
CONFIG_HEAP_MEM_POOL_SIZE=1024

# Debug-tulosteiden varmuus
CONFIG_LOG=y
CONFIG_LOG_DEFAULT_LEVEL=3
```

## src/main.c
```c
#include <zephyr/kernel.h>
#include <zephyr/sys/printk.h>
#include "led_example.h"
#include "button_example.h"
#include "dispatcher.h"
#include "uartDef.h"

#define	STACKSIZE	1024
#define	PRIORITY	5

// K_THREAD_DEFINE(liikennevalot_thread, STACKSIZE, valotila_task, NULL, NULL, NULL, PRIORITY, 0, 0);

// Unohdin palautuksen laittaa kun loin tätä ennen lomaa. Tähtäsin tällä tuotoksella muistaakseni 2:een pisteeseen.

// Main program
int main(void) {
    printk("Koitetaan rullaa softaa.\n");
    uartDef_init();
    dispatcher_init();   
    init_button();
    init_led();

    return 0;
}


// valkoinen valo 
/*
K_THREAD_DEFINE(red_thread, STACKSIZE, red_led_task, NULL, NULL, NULL, PRIORITY, 0, 0);
K_THREAD_DEFINE(green_thread, STACKSIZE, green_led_task, NULL, NULL, NULL, PRIORITY, 0, 0);
K_THREAD_DEFINE(blue_thread, STACKSIZE, blue_led_task, NULL, NULL, NULL, PRIORITY, 0, 0);
*/
```

## src/button_example.c
```c
#include <zephyr/kernel.h>
#include <zephyr/device.h>
#include <zephyr/drivers/gpio.h>
#include <zephyr/sys/util.h>
#include <zephyr/sys/printk.h>
#include <inttypes.h>
#include "dispatcher.h"

// Configure buttons
#define BUTTON_0 DT_ALIAS(sw0)
#define BUTTON_1 DT_ALIAS(sw1)
#define BUTTON_2 DT_ALIAS(sw2)

static const struct gpio_dt_spec button_0 = GPIO_DT_SPEC_GET_OR(BUTTON_0, gpios, {0});
static const struct gpio_dt_spec button_1 = GPIO_DT_SPEC_GET_OR(BUTTON_1, gpios, {0});
static const struct gpio_dt_spec button_2 = GPIO_DT_SPEC_GET_OR(BUTTON_2, gpios, {0});

static struct gpio_callback button_cb_data[3];

// Shared handler for all buttons
void button_handler(const struct device *dev, struct gpio_callback *cb, uint32_t pins)
{
    char msg_char = 0;

    // Pienet kirjaimet vastaavat dispatcherin logiikkaa
    if (pins & BIT(button_0.pin)) msg_char = 'r';
    else if (pins & BIT(button_1.pin)) msg_char = 'y';
    else if (pins & BIT(button_2.pin)) msg_char = 'g';

    if (msg_char) {
        printk("Button pressed -> sending '%c'\n", msg_char);
        dispatcher_event_t evt = {
            .type = EVENT_LED_CMD,
            .msg = {msg_char, '\0'}  // 1 merkki + null-terminaattori
        };
        dispatcher_post(&evt);
    }
}

// Initialize one button (helper)
static int setup_button(const struct gpio_dt_spec *button, struct gpio_callback *cb)
{
    if (!device_is_ready(button->port)) {
        printk("Button port not ready\n");
        return -1;
    }

    int ret = gpio_pin_configure_dt(button, GPIO_INPUT);
    if (ret) return ret;

    ret = gpio_pin_interrupt_configure_dt(button, GPIO_INT_EDGE_TO_ACTIVE);
    if (ret) return ret;

    gpio_init_callback(cb, button_handler, BIT(button->pin));
    gpio_add_callback(button->port, cb);

    return 0;
}

// Initialize all buttons
int init_button() {
    int ret = 0;

    printk("Initializing buttons...\n");

    ret |= setup_button(&button_0, &button_cb_data[0]);
    ret |= setup_button(&button_1, &button_cb_data[1]);
    ret |= setup_button(&button_2, &button_cb_data[2]);

    if (ret == 0)
        printk("All buttons initialized successfully.\n");
    else
        printk("One or more buttons failed to initialize.\n");

    return ret;
}
```

## src/dispatcher.c
```c
#include <zephyr/kernel.h>       // sisältää K_FOREVER, K_FIFO_DEFINE, k_sem jne.
#include <zephyr/sys/printk.h>
#include <string.h>
#include "led_example.h"
#include "dispatcher.h"

// Viittaukset LED-taskien semafooreihin (määritelty led_example.c:ssä)
extern struct k_sem red_sem;
extern struct k_sem green_sem;
extern struct k_sem yellow_sem;
extern struct k_sem release_sem;

// FIFO määrittely dispatcherille
K_FIFO_DEFINE(dispatcher_fifo);

// Dispatcherille tapahtuman lähetys FIFOon
void dispatcher_post(dispatcher_event_t *evt) {
    dispatcher_event_t *copy = k_malloc(sizeof(dispatcher_event_t));
    if (copy) {
        memcpy(copy, evt, sizeof(dispatcher_event_t));
        printk("Dispatcher: received event '%s'\n", evt->msg);
        k_fifo_put(&dispatcher_fifo, copy);
    } else {
        printk("Dispatcher: memory alloc failed!\n");
    }
}

// Dispatcher-task, joka lukee FIFOa ja ohjaa valotaskien semafooreja
static void dispatcher_task(void *p1, void *p2, void *p3) {
    ARG_UNUSED(p1);
    ARG_UNUSED(p2);
    ARG_UNUSED(p3);

    printk("Dispatcher task started\n");

    while (1) {
        dispatcher_event_t *evt = k_fifo_get(&dispatcher_fifo, K_FOREVER);
        if (!evt) {
            continue;
        }

        printk("Dispatcher: got event -> '%s'\n", evt->msg);

        switch (evt->msg[0]) {
        case 'r':
            printk("Dispatcher: activating RED\n");
            k_sem_take(&release_sem, K_FOREVER);
            k_sem_give(&red_sem);
            break;
        case 'y':
            printk("Dispatcher: activating YELLOW\n");
            k_sem_take(&release_sem, K_FOREVER);
            k_sem_give(&yellow_sem);
            break;
        case 'g':
            printk("Dispatcher: activating GREEN\n");
            k_sem_take(&release_sem, K_FOREVER);
            k_sem_give(&green_sem);
            break;
        default:
            printk("Dispatcher: unknown symbol '%c'\n", evt->msg[0]);
            break;
        }

        k_free(evt);
    }
}

// Dispatcher-säikeen määrittely
K_THREAD_DEFINE(dispatch_thread, 1024, dispatcher_task, NULL, NULL, NULL, 5, 0, 0);

// Dispatcher-moduulin alustus
void dispatcher_init(void) {
    printk("Dispatcher initialized\n");
}
```

## src/dispatcher.h
```c
#ifndef DISPATCHER_H
#define DISPATCHER_H

typedef enum {
    EVENT_LED_CMD
} event_type_t;

typedef struct {
    void *fifo_reserved;  // tarvitaan Zephyr FIFOon
    event_type_t type;
    char msg[20];         // tämä kenttä tarvitaan dispatcherissa
} dispatcher_event_t;

void dispatcher_post(dispatcher_event_t *evt);
void dispatcher_init(void);

#endif
```

## src/led_example.c
```c
#include <zephyr/kernel.h>
#include <zephyr/sys/printk.h>
#include <zephyr/device.h>
#include <zephyr/drivers/gpio.h>
#include "led_example.h"

K_SEM_DEFINE(red_sem, 0, 1);
K_SEM_DEFINE(green_sem, 0, 1);
K_SEM_DEFINE(yellow_sem, 0, 1);
K_SEM_DEFINE(release_sem, 1, 1);

// Led pin configurations
static const struct gpio_dt_spec red = GPIO_DT_SPEC_GET(DT_ALIAS(led0), gpios);
static const struct gpio_dt_spec green = GPIO_DT_SPEC_GET(DT_ALIAS(led1), gpios);
static const struct gpio_dt_spec blue = GPIO_DT_SPEC_GET(DT_ALIAS(led2), gpios);

// Thread function prototypes
static void red_task(void *, void *, void *);
static void green_task(void *, void *, void *);
static void yellow_task(void *, void *, void *);




// Initialize leds
int init_led() {
    int ret = gpio_pin_configure_dt(&red, GPIO_OUTPUT_INACTIVE);
	if (ret) return ret;
	ret = gpio_pin_configure_dt(&green, GPIO_OUTPUT_INACTIVE);
	if (ret) return ret;
	ret = gpio_pin_configure_dt(&blue, GPIO_OUTPUT_INACTIVE);
	if (ret) return ret;
    printk("Led initialization ok\n");
    return 0;
}

static void set_leds(int r, int g, int b) {
	gpio_pin_set_dt(&red, r);
	gpio_pin_set_dt(&green, g);
	gpio_pin_set_dt(&blue, b);
}
static void red_task(void *p1, void *p2, void *p3) {
	while (1) {
		k_sem_take(&red_sem, K_FOREVER);
		set_leds(1, 0, 0);
		printk("Red on\n");
		k_sleep(K_SECONDS(1));
		set_leds(0, 0, 0);
		printk("Red off\n");
		k_sem_give(&release_sem);
	}
}
static void green_task(void *p1, void *p2, void *p3) {
	while (1) {
		k_sem_take(&green_sem, K_FOREVER);
		set_leds(0, 1, 0);
		printk("Green on\n");
		k_sleep(K_SECONDS(1));
		set_leds(0, 0, 0);
		printk("Green off\n");
		k_sem_give(&release_sem);
	}
}
static void yellow_task(void *p1, void *p2, void *p3) {
	while (1) {
		k_sem_take(&yellow_sem, K_FOREVER);
		set_leds(1, 1, 0);
		printk("Blue on\n");
		k_sleep(K_SECONDS(1));
		set_leds(0, 0, 0);
		printk("Blue off\n");
		k_sem_give(&release_sem);
	}
}

K_THREAD_DEFINE(red_thread, 1024, red_task, NULL, NULL, NULL, 5, 0, 0);
K_THREAD_DEFINE(green_thread, 1024, green_task, NULL, NULL, NULL, 5, 0, 0);
K_THREAD_DEFINE(yellow_thread, 1024, yellow_task, NULL, NULL, NULL, 5, 0, 0);
```

## src/led_example.h
```c
#ifndef LED_EXAMPLE_H
#define LED_EXAMPLE_H

int init_led(void);
void valotila_task(void *, void *, void*);
/*
void red_led_task(void *, void *, void *);
void green_led_task(void *, void *, void *);
void blue_led_task(void *, void *, void *);
*/
#endif // LED_EXAMPLE_H
```

## src/uartDef.c
```c
#include "uartDef.h"
#include "dispatcher.h"
#include <zephyr/drivers/uart.h>
#include <zephyr/sys/printk.h>
#include <zephyr/kernel.h>
#include <zephyr/device.h>
#include <string.h>

#define UART_DEVICE_NODE DT_CHOSEN(zephyr_shell_uart)
static const struct device *const uart_dev = DEVICE_DT_GET(UART_DEVICE_NODE);

static void uart_cb(const struct device *dev, void *user_data) {
    uint8_t c;
    if (uart_irq_update(dev) && uart_irq_rx_ready(dev)) {
        while (uart_fifo_read(dev, &c, 1) == 1) {
            dispatcher_event_t evt = { .type = EVENT_LED_CMD };
            evt.msg[0] = c;
            evt.msg[1] = '\0';
            dispatcher_post(&evt);
        }
    }
}

void uartDef_init(void) {
    if (!device_is_ready(uart_dev)) {
        printk("Error: UART device not ready\n");
        return;
    }
    uart_irq_callback_user_data_set(uart_dev, uart_cb, NULL);
    uart_irq_rx_enable(uart_dev);
    printk("UART initialized with RX interrupt\n");
}
```
